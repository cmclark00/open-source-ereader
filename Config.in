## Config.in
```kconfig
source "$BR2_EXTERNAL_EREADER_PATH/package/display-test/Config.in"
source "$BR2_EXTERNAL_EREADER_PATH/package/button-test/Config.in"
source "$BR2_EXTERNAL_EREADER_PATH/package/ereader/Config.in"
```

## configs/ereader_rpi0w_defconfig
```kconfig
# Architecture and CPU settings for Raspberry Pi Zero W
BR2_arm=y
BR2_arm1176jzf_s=y
BR2_ARM_EABIHF=y

# Linux kernel version - 6.1 LTS series for stability
BR2_PACKAGE_HOST_LINUX_HEADERS_CUSTOM_6_1=y

# Enable C++ toolchain support for future features
BR2_TOOLCHAIN_BUILDROOT_CXX=y

# Linux kernel configuration
BR2_LINUX_KERNEL=y
BR2_LINUX_KERNEL_CUSTOM_TARBALL=y
BR2_LINUX_KERNEL_CUSTOM_TARBALL_LOCATION="$(call github,raspberrypi,linux,17f135b742c4edb340afb365873c3a574f7e16cb)/linux-17f135b742c4edb340afb365873c3a574f7e16cb.tar.gz"
BR2_LINUX_KERNEL_DEFCONFIG="bcmrpi"
BR2_LINUX_KERNEL_DTS_SUPPORT=y
BR2_LINUX_KERNEL_INTREE_DTS_NAME="bcm2708-rpi-zero-w"
BR2_LINUX_KERNEL_NEEDS_HOST_OPENSSL=y

# Enable kernel headers for building modules
BR2_KERNEL_HEADERS_AS_KERNEL=y

# Apply custom kernel configuration fragment for SPI, GPIO, and framebuffer support
BR2_LINUX_KERNEL_CONFIG_FRAGMENT_FILES="configs/linux_ereader.fragment"

# Raspberry Pi firmware
BR2_PACKAGE_RPI_FIRMWARE=y
BR2_PACKAGE_RPI_FIRMWARE_BOOTCODE_BIN=y
BR2_PACKAGE_RPI_FIRMWARE_VARIANT_PI=y
BR2_PACKAGE_RPI_FIRMWARE_CONFIG_FILE="board/ereader/config_ereader.txt"

# System configuration
BR2_TARGET_GENERIC_HOSTNAME="ereader"
BR2_TARGET_GENERIC_ISSUE="Welcome to E-Reader"
BR2_ROOTFS_DEVICE_CREATION_DYNAMIC_EUDEV=y

# Root filesystem overlay - adds sample books and init scripts
BR2_ROOTFS_OVERLAY="board/ereader/rootfs-overlay"

# Root password for development (change in production!)
BR2_TARGET_GENERIC_ROOT_PASSWD="ereader"

# Enable getty on serial console for debugging
BR2_TARGET_GENERIC_GETTY=y
BR2_TARGET_GENERIC_GETTY_PORT="ttyAMA0"
BR2_TARGET_GENERIC_GETTY_BAUDRATE_115200=y

# Filesystem configuration - ext4 for reliability
BR2_TARGET_ROOTFS_EXT2=y
BR2_TARGET_ROOTFS_EXT2_4=y
BR2_TARGET_ROOTFS_EXT2_SIZE="256M"

# Disable TAR filesystem to save space
# BR2_TARGET_ROOTFS_TAR is not set

# Required host tools to create the SD image
BR2_PACKAGE_HOST_DOSFSTOOLS=y
BR2_PACKAGE_HOST_GENIMAGE=y
BR2_PACKAGE_HOST_MTOOLS=y

# Enable compressed kernel module support
BR2_PACKAGE_BUSYBOX_SHOW_OTHERS=y
BR2_PACKAGE_KMOD_TOOLS=y
BR2_PACKAGE_XZ=y
BR2_PACKAGE_KMOD=y
BR2_PACKAGE_HOST_KMOD_XZ=y

# Development and debugging utilities
BR2_PACKAGE_STRACE=y
BR2_PACKAGE_LTRACE=y
BR2_PACKAGE_GDB=y
BR2_PACKAGE_GDB_SERVER=y

# WiFi and networking packages (Phase 6)
# Broadcom WiFi firmware for Pi Zero W (brcmfmac43430)
BR2_PACKAGE_RPI_WIFI_FIRMWARE=y

# WPA supplicant for WPA/WPA2 authentication
BR2_PACKAGE_WPA_SUPPLICANT=y
BR2_PACKAGE_WPA_SUPPLICANT_CLI=y
BR2_PACKAGE_WPA_SUPPLICANT_WPA_CLIENT_SO=y
BR2_PACKAGE_WPA_SUPPLICANT_PASSPHRASE=y

# Wireless tools for WiFi management
BR2_PACKAGE_WIRELESS_TOOLS=y
BR2_PACKAGE_IW=y

# DHCP client for automatic IP address assignment
BR2_PACKAGE_DHCPCD=y

# DNS resolver
BR2_PACKAGE_BIND=y
BR2_PACKAGE_BIND_TOOLS=y

# Network utilities for downloading books
BR2_PACKAGE_WGET=y

# Time synchronization via NTP (chrony - lightweight and efficient)
BR2_PACKAGE_CHRONY=y

# Libraries for EPUB support (Phase 4)
BR2_PACKAGE_LIBZIP=y
BR2_PACKAGE_LIBXML2=y

# Libraries for PDF support (Phase 4)
# Using Poppler instead of MuPDF to avoid X11 dependency
BR2_PACKAGE_POPPLER=y
BR2_PACKAGE_POPPLER_UTILS=y

# E-Reader custom packages
BR2_PACKAGE_DISPLAY_TEST=y
BR2_PACKAGE_BUTTON_TEST=y
BR2_PACKAGE_EREADER=y

# Post-build and post-image scripts
BR2_ROOTFS_POST_BUILD_SCRIPT="board/ereader/post-build.sh"
BR2_ROOTFS_POST_IMAGE_SCRIPT="board/ereader/post-image.sh"
BR2_ROOTFS_POST_SCRIPT_ARGS="--genimage-config board/ereader/genimage.cfg"
```

## os/buildroot/buildroot-2024.02.7/configs/ereader_rpizerow_defconfig
```kconfig
# E-Reader Buildroot configuration for Raspberry Pi Zero W
# Based on ereader_rpi4_64_defconfig but adapted for Pi Zero W hardware

# Target Architecture - ARM (32-bit) for BCM2835
BR2_arm=y
BR2_arm1176jzf_s=y
BR2_ARM_EABIHF=y

# Use musl C library for smaller footprint
BR2_TOOLCHAIN_BUILDROOT_MUSL=y
# Linux headers same as kernel, 6.1 series
BR2_PACKAGE_HOST_LINUX_HEADERS_CUSTOM_6_1=y
# Enable C++ support (needed for some packages)
BR2_TOOLCHAIN_BUILDROOT_CXX=y

# System Configuration
BR2_TARGET_GENERIC_HOSTNAME="ereader"
BR2_TARGET_GENERIC_ISSUE="Welcome to E-Reader OS"
BR2_TARGET_GENERIC_GETTY_OPTIONS="-a root"
BR2_SYSTEM_DHCP="wlan0"

# Filesystem overlay and scripts
BR2_ROOTFS_OVERLAY="board/raspberrypi/ereader-overlay"
BR2_ROOTFS_POST_BUILD_SCRIPT="board/raspberrypi0w/post-build.sh"
BR2_ROOTFS_POST_IMAGE_SCRIPT="board/raspberrypi0w/post-image.sh"

# Linux Kernel
BR2_LINUX_KERNEL=y
BR2_LINUX_KERNEL_CUSTOM_TARBALL=y
BR2_LINUX_KERNEL_CUSTOM_TARBALL_LOCATION="$(call github,raspberrypi,linux,17f135b742c4edb340afb365873c3a574f7e16cb)/linux-17f135b742c4edb340afb365873c3a574f7e16cb.tar.gz"
BR2_LINUX_KERNEL_DEFCONFIG="bcmrpi"
BR2_LINUX_KERNEL_CONFIG_FRAGMENT_FILES="board/raspberrypi/ereader-kernel.fragment"
BR2_LINUX_KERNEL_DTS_SUPPORT=y
BR2_LINUX_KERNEL_INTREE_DTS_NAME="bcm2708-rpi-zero-w"
BR2_LINUX_KERNEL_NEEDS_HOST_OPENSSL=y

# BusyBox
BR2_PACKAGE_BUSYBOX_SHOW_OTHERS=y

# Compression tools
BR2_PACKAGE_XZ=y

# Raspberry Pi Firmware
BR2_PACKAGE_RPI_FIRMWARE=y
BR2_PACKAGE_RPI_FIRMWARE_BOOTCODE_BIN=y
BR2_PACKAGE_RPI_FIRMWARE_VARIANT_PI=y
BR2_PACKAGE_RPI_FIRMWARE_CONFIG_FILE="board/raspberrypi/config_ereader_zerow.txt"

# Python 3 (for reader application)
BR2_PACKAGE_PYTHON3=y

# Device Tree Compiler
BR2_PACKAGE_DTC=y
BR2_PACKAGE_DTC_PROGRAMS=y

# Linux Firmware (for WiFi)
BR2_PACKAGE_LINUX_FIRMWARE=y
BR2_PACKAGE_LINUX_FIRMWARE_BRCM_BCM43XXX=y

# Network Packages
BR2_PACKAGE_DHCPCD=y
BR2_PACKAGE_DROPBEAR=y
BR2_PACKAGE_IW=y
BR2_PACKAGE_OPENSSH=y
BR2_PACKAGE_WIRELESS_TOOLS=y
BR2_PACKAGE_WPA_SUPPLICANT=y
BR2_PACKAGE_WPA_SUPPLICANT_CLI=y
BR2_PACKAGE_WPA_SUPPLICANT_WPA_CLIENT_SO=y
BR2_PACKAGE_WPA_SUPPLICANT_PASSPHRASE=y

# Kernel Module Tools
BR2_PACKAGE_KMOD=y
BR2_PACKAGE_KMOD_TOOLS=y

# Filesystem Settings
BR2_TARGET_ROOTFS_EXT2=y
BR2_TARGET_ROOTFS_EXT2_4=y
BR2_TARGET_ROOTFS_EXT2_SIZE="120M"
# BR2_TARGET_ROOTFS_TAR is not set

# Host Tools (for SD card image creation)
BR2_PACKAGE_HOST_DOSFSTOOLS=y
BR2_PACKAGE_HOST_GENIMAGE=y
BR2_PACKAGE_HOST_KMOD_XZ=y
BR2_PACKAGE_HOST_MTOOLS=y
```

## package/button-test/Config.in
```kconfig
config BR2_PACKAGE_BUTTON_TEST
	bool "button-test"
	help
	  GPIO Button Input Test Application for E-Reader.

	  This application tests the GPIO button input system by reading
	  button events from the Linux input subsystem (/dev/input/eventX)
	  and displaying them to the console. It verifies that the button
	  hardware and device tree configuration are working correctly.

	  The application uses the Linux input event interface (evdev) to
	  read button presses from the gpio-keys driver. It implements
	  software debouncing and provides color-coded console output for
	  easy verification.

	  Button Layout:
	    - UP (GPIO 5)     - Navigate up
	    - DOWN (GPIO 6)   - Navigate down
	    - SELECT (GPIO 13) - Confirm/Enter
	    - BACK (GPIO 19)   - Go back/Cancel
	    - MENU (GPIO 26)   - Open menu

	  https://github.com/yourusername/open-source-ereader
```

## package/display-test/Config.in
```kconfig
config BR2_PACKAGE_DISPLAY_TEST
	bool "display-test"
	help
	  E-Paper Display Test Application for Waveshare 4.2" display.

	  This application tests the Waveshare 4.2" e-paper display
	  by initializing the display via SPI and drawing "Hello E-Reader"
	  text using a basic bitmap font. It verifies that the hardware
	  and software stack are working correctly.

	  The application uses SPI device interface (/dev/spidev0.0) and
	  GPIO sysfs interface for display control signals (RST, DC, BUSY).

	  https://github.com/yourusername/open-source-ereader
```

## package/ereader/Config.in
```kconfig
config BR2_PACKAGE_EREADER
	bool "ereader"
	select BR2_PACKAGE_DISPLAY_TEST
	select BR2_PACKAGE_BUTTON_TEST
	help
	  E-Reader Application - Full-featured e-reader for Raspberry Pi Zero W.

	  This is the main e-reader application that provides a complete
	  reading experience on the Waveshare 4.2" e-paper display. It includes:

	  Features:
	    - Boot-to-reader: Automatic startup with menu display
	    - Library management: Browse and select books from /books/ directory
	    - Text rendering: Word-wrapped text display with pagination
	    - Page navigation: Turn pages with UP/DOWN buttons
	    - Bookmark support: Automatic position saving to /etc/ereader/bookmarks.txt
	    - Status display: Shows current page, total pages, and book title

	  Hardware Requirements:
	    - Raspberry Pi Zero W (512MB RAM)
	    - Waveshare 4.2" E-Paper Display (400x300, SPI interface)
	    - 5 GPIO buttons (UP, DOWN, SELECT, BACK, MENU)

	  Supported Formats:
	    - Plain text files (.txt)
	    - UTF-8 and ASCII encoding
	    - Maximum file size: 10MB per book

	  Display Specifications:
	    - 400x300 pixel display
	    - 8x16 bitmap font
	    - 14 lines per page
	    - 47 characters per line

	  Usage:
	    - Copy .txt files to /books/ directory
	    - Power on device - boots directly to library menu
	    - Navigate with UP/DOWN buttons
	    - Press SELECT to open a book
	    - Press BACK to return to menu
	    - Reading position is saved automatically

	  This package depends on display-test (EPD driver) and button-test
	  (input system) and integrates them into a cohesive application.

	  https://github.com/yourusername/open-source-ereader
```
